// SPDX-License-Identifier: MIT
/*
 * Bring-up only (CAMERA-PLAN.md, RC2.1-RC2.2): the ultrawide's CSIS link 1
 * and the shared DC-PHY. The nodes, the IMX386 endpoint and the cam clock
 * are in the kernel (gs101.dtsi, gs101-raven.dts, kernel cda13b14b on),
 * disabled; this turns them on. Needs camera-csis-cmu-test (pd_csis's
 * DTZPC, cmu_csis) and camera-uw-test (the sensor). phy_gs201_mipi_dcphy_rx
 * and gs201_csis are blacklisted on the phone before a DTB with this
 * overlay boots; tools/camera-cap-test loads them.
 */
/dts-v1/;
/plugin/;

&csis1 {
	status = "okay";
};

&csis_dcphy {
	status = "okay";
};
