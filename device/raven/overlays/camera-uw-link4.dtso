// SPDX-License-Identifier: MIT
/*
 * Bring-up only (CAMERA-PLAN.md, RC2.1e): the ultrawide on CSIS link 4
 * (DC-PHY slaves 4 and 5 as one four-lane receiver) instead of link 2,
 * used instead of camera-uw-stream for one boot. RC2.1b-d streamed colour
 * bars from the IMX386 while links 2, 0 and 6 saw nothing at all. csis2
 * stays disabled; its stale endpoint is never parsed.
 */
/dts-v1/;
/plugin/;

&csis4 {
	memory-region = <&camera_pool>;
	status = "okay";
};

&csis4_in {
	remote-endpoint = <&uw_out>;
	data-lanes = <1 2 3 4>;
};

&uw_out {
	remote-endpoint = <&csis4_in>;
};

&csis_dcphy {
	status = "okay";
};
