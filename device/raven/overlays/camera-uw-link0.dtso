// SPDX-License-Identifier: MIT
/*
 * Bring-up only (CAMERA-PLAN.md, RC2.1c): the ultrawide on CSIS link 0
 * (its own four-lane DC-PHY slave) instead of link 2, used instead of
 * camera-uw-stream for one boot. RC2.1b streamed colour bars from the
 * IMX386 while link 2 saw nothing at all. csis2 stays disabled; its stale
 * endpoint is never parsed.
 */
/dts-v1/;
/plugin/;

&csis0 {
	memory-region = <&camera_pool>;
	status = "okay";
};

&csis0_in {
	remote-endpoint = <&uw_out>;
	data-lanes = <1 2 3 4>;
};

&uw_out {
	remote-endpoint = <&csis0_in>;
};

&csis_dcphy {
	status = "okay";
};
