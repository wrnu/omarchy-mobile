// SPDX-License-Identifier: MIT
/*
 * Bring-up only (CAMERA-PLAN.md, RC2.1d): the ultrawide on CSIS link 6
 * (DC-PHY slaves 6 and 7 as one four-lane receiver) instead of link 2,
 * used instead of camera-uw-stream for one boot. RC2.1b and RC2.1c
 * streamed colour bars from the IMX386 while links 2 and 0 saw nothing at
 * all. csis2 stays disabled; its stale endpoint is never parsed.
 */
/dts-v1/;
/plugin/;

&csis6 {
	memory-region = <&camera_pool>;
	status = "okay";
};

&csis6_in {
	remote-endpoint = <&uw_out>;
	data-lanes = <1 2 3 4>;
};

&uw_out {
	remote-endpoint = <&csis6_in>;
};

&csis_dcphy {
	status = "okay";
};
