// SPDX-License-Identifier: MIT
/*
 * Bring-up only (CAMERA-PLAN.md, RC2.0m-n): camera-csis-test without the
 * clock. A simple-pm-bus that holds only pd_csis, so that
 * tools/camera-csis-probe (READ=0) can power-cycle the domain through
 * genpd without ever touching CMU_TOP's CSIS bus clock. In RC2.0b and
 * RC2.0f the power-off stuck (STATUS 0x1) after simple-pm-bus had gated
 * that clock; this tells whether the gating is what sticks. Replaces
 * camera-csis-test and camera-csis-abl-test.
 */
/dts-v1/;
/plugin/;

&{/soc@0} {
	bus@1a440000 {
		compatible = "simple-pm-bus";
		#address-cells = <1>;
		#size-cells = <1>;
		ranges = <0x0 0x1a440000 0x1000>;
		power-domains = <&pd_csis>;
	};
};
